## drivers/input/touchscreen/nt36xxxspi/Kconfig
```kconfig
#
# Novatek NT36xxx SPI touchscreen driver configuration
#
config TOUCHSCREEN_NT36XXXSPI
	tristate "Novatek NT36xxx SPI driver"
	depends on !TOUCHSCREEN_NT36XXX
	help
	  Say Y here if you have a Novatek NT36xxx no flash touchscreen connected
	  to your system by SPI bus.

	  If unsure, say N.
```

## drivers/staging/qcacld-3.0/Kconfig
```kconfig
comment "Qualcomm Atheros CLD WLAN module"

config QCA_CLD_WLAN
	tristate "Qualcomm Atheros CLD WLAN module"
	default n
	help
	  Add support for the Qualcomm Atheros CLD WLAN module

if QCA_CLD_WLAN != n

config QCA_CLD_WLAN_DEBUG
	bool "Debug symbols for Qualcomm Atheros CLD WLAN module"
	default n
	help
		Add debug symbols for the Qualcomm Atheros CLD WLAN module,
		may result in much larger binaries.

		If unsure, say N.

config QCA_CLD_WLAN_PROFILE
	string "Configuration profile for Qualcomm Atheros CLD WLAN module"
	default "default"
	help
	  Specify which configuration profile to be used for building
	  this module.

	  Profiles are located at drivers/staging/qcacld-3.0/configs.

endif # QCA_CLD_WLAN
```
